## software/esp32/application/main/Kconfig.projbuild
```kconfig
menu "Application Configuration"

    config PRESENTS_TO_THE_MOON_AUDIO_PIN_0
        int "Audio pin 0"
        default 44
        help
            GPIO pin wired to pin IO0 of the DY-HV8F audio board.

    config PRESENTS_TO_THE_MOON_AUDIO_PIN_1
        int "Audio pin 1"
        default 2
        help
            GPIO pin wired to pin IO1 of the DY-HV8F audio board.

    config PRESENTS_TO_THE_MOON_AUDIO_PIN_2
        int "Audio pin 2"
        default 5
        help
            GPIO pin wired to pin IO2 of the DY-HV8F audio board.

    config PRESENTS_TO_THE_MOON_AUDIO_PIN_3
        int "Audio pin 3"
        default -1
        help
            GPIO pin wired to pin IO3 of the DY-HV8F audio board.

endmenu
```

## software/esp32/components/ht16k33a/Kconfig.projbuild
```kconfig
menu "HT16K33A Configuration"

    config HT16K33A_I2C_NUM
        int "The I2C port to use to talk to a HT16K33A 14-digit display driver"
        default 0
        range -1 1

    config HT16K33A_I2C_SCL_PIN
        int "HT16K33A I2C clock GPIO"
        default 4

    config HT16K33A_I2C_SDA_PIN
        int "TMC5160 I2C SDA GPIO"
        default 43

    config HT16K33A_I2C_CLOCK_HZ
        int "HT16K33A I2C clock frequency (Hz)"
        default 100000

endmenu
```
